## sdkconfig.defaults
```kconfig
# GBS-Control ESP-IDF Default Configuration
# Supported targets: ESP32-C3 / ESP32-C6 (RISC-V)

# --- CPU ---
CONFIG_ESP_DEFAULT_CPU_FREQ_MHZ_160=y

# --- Flash ---
CONFIG_ESPTOOLPY_FLASHSIZE_4MB=y

# --- Partition Table ---
CONFIG_PARTITION_TABLE_CUSTOM=y
CONFIG_PARTITION_TABLE_CUSTOM_FILENAME="partitions.csv"

# --- WiFi ---
CONFIG_ESP_WIFI_SOFTAP_ENABLED=y
CONFIG_ESP_WIFI_NVS_ENABLED=y

# --- HTTPD ---
CONFIG_HTTPD_MAX_REQ_HDR_LEN=1024
CONFIG_HTTPD_MAX_URI_LEN=512
CONFIG_HTTPD_WS_SUPPORT=y

# --- mDNS ---
CONFIG_MDNS_MAX_SERVICES=5

# --- LWIP ---
CONFIG_LWIP_MAX_SOCKETS=10

# --- FreeRTOS ---
CONFIG_FREERTOS_HZ=1000

# --- SPIFFS ---
CONFIG_SPIFFS_MAX_PARTITIONS=3

# --- Log Level ---
CONFIG_LOG_DEFAULT_LEVEL_INFO=y

# --- Compiler ---
CONFIG_COMPILER_CXX_EXCEPTIONS=y
CONFIG_COMPILER_CXX_RTTI=y
CONFIG_COMPILER_OPTIMIZATION_SIZE=y

# --- Stack sizes ---
CONFIG_ESP_MAIN_TASK_STACK_SIZE=8192

# --- I2C ---
# Using driver/i2c for I2C master

# --- BLE (NimBLE) ---
CONFIG_BT_ENABLED=y
CONFIG_BT_NIMBLE_ENABLED=y
CONFIG_BT_NIMBLE_MAX_CONNECTIONS=1
CONFIG_BT_NIMBLE_ROLE_PERIPHERAL=y
CONFIG_BT_NIMBLE_ROLE_CENTRAL=n
CONFIG_BT_NIMBLE_ROLE_OBSERVER=n
CONFIG_BT_NIMBLE_ROLE_BROADCASTER=n
CONFIG_BT_NIMBLE_NVS_PERSIST=y

# --- Watchdog ---
CONFIG_ESP_TASK_WDT_TIMEOUT_S=10
```
